;------VARIBLE ADDR---------------------
STACKADDR EQU 030h
NUM EQU 23h ;SO CAN HIEN THI
HOURS EQU 24h ;BIEN CHUA GIO
MINUTE EQU 25h ;BIEN CHUA PHUT
DAY EQU 26h ;BIEN CHUA NGAY
MONTH EQU 27h ;BIEN CHUA THANG
YEAR EQU 28h ;BIEN CHUA NAM
ALH EQU 29h ;BIEN CHUA GIO DUOC HEN
ALM EQU 02Ah ;BIEN CHUA PHUT DUOC HEN
VAR1 EQU 02Bh ;BIEN TAM
VAR2 EQU 02Ch ;BIEN TAM
VAR3 EQU 02Dh ;BIEN TAM
BUFF EQU 02Eh ;DU LIEU CAN GUI
ADDRSEG EQU 02Fh ;DIA CHI O NHO CAN LAY GUI
RPTIME EQU 030h ;SO LAN LAP BAO THUC
;------DEFINE BIT---------------------
D4 EQU 00h ;DOT 4 SET
D3 EQU 01h ;DOT 3 SET
D2 EQU 02h ;DOT 2 SET
D1 EQU 03h ;DOT 1 SET
YC EQU 04h ;CHANGE YEAR
DC EQU 05h ;CHANGE DAY
HC EQU 06h ;CHANGE HOURS
ALSET EQU 07h ;ALARM SETTED
VB0 EQU 08h ; BIEN LUU BIT
VB1 EQU 09h ; BIEN LUU BIT 
LB0 EQU 0Ah ; BIEN LUU BIT
LB1 EQU 0Bh ; BIEN LUU BIT
DOT EQU 0Ch ; BIEN CHI THI HIEN DAU CHAM'
RINGED EQU 0Dh;BIEN DUOC SET NEU ALARM DA RING ROI
UPDATTING EQU 0Eh;BIEN DC SET NEU DA GOI HAM UPDATE
HM EQU P3.3 ;HOURS MINUTE MODE
DM EQU P3.4 ;DAY MONTH MODE
YM EQU P3.5 ;YEAR MODE
AM EQU P3.6 ;ALARM MODE
SETCL EQU R2
CLRCL EQU R3
SETDTA EQU R4
CLRDTA EQU R5
SETDIS EQU R6
CLRDIS EQU R7
SDA EQU P3.1
SCL EQU P3.0
RWB EQU CY
BTMODE EQU P0.0
BTSLCT EQU P0.1
BTINC  EQU P0.2 
SPACEDOT EQU P2.4
BELL EQU P2.5
;----------JUMP TO MAIN PROGRAM---------------
ORG 00H
SJMP SETTING
;----------INTERRUPT OUTSIDE0-----------------
ORG 03h
CALL MAINCHECK
RETI
;----------INTERRUPT TIMER0-------------------
ORG 0Bh
CLR TR0
CALL UPDATE
MOV TH0,#03Ch
MOV TL0,#0B0h
SETB TR0
RETI
;---------SETTING 8051------------------------
SETTING:
MOV SP,#STACKADDR
MOV P1,#00h
MOV P2,#00h
CLR ALSET
SETB SPACEDOT
CLR D1
CLR D2
CLR D3
CLR D4
CLR RINGED
MOV P3,#0Fh ;DAT STATE CUA CAC CHAN HM=1,DM=YM=AM=0,SDA=SCL=1
;---------SETTING DS1307---------------------
MOV BUFF,#0h ;SECOND ADDRESS ON DS1307
MOV ADDRSEG,#00h;DAT DS1307 VAO CHE DO HOAT DONG
CALL WRITE
MOV ADDRSEG,#02h
MOV BUFF,#0E0h;DIA CHI NHO CUA THANH GHI A
CALL READ
MOV HOURS,A
ANL A,#0BFh ;SET BIT MODE 24h
MOV BUFF,A
CALL WRITE ;SET MODE 24h 
CALL UPDATE
;-----------8051 SETTING INTERRUPT-----------
;DO UU TIEN : NGAT NGOAI 0 , NGAT TIMMER 0
MOV TH0,#03Ch
MOV TL0,#0B0h
MOV RPTIME,#00h
MOV TMOD,#011h ;SET LUN CHO BO DINH TIMER 1
CLR TF0
SETB IT0
MOV IE,#083h
SETB TR0
;-----------MAKEIDLE MODE--------------------
IDLESTATE:
NOP
NOP
NOP
NOP
ORL PCON,#01h ;DUA CPU VAO IDLE MODE
SJMP IDLESTATE
;----------MAIN CHECK------------------------
MAINCHECK:
MOV C,RS0
MOV VB0,C
MOV C,RS1
MOV VB1,C
CLR RS0
CLR RS1
MOV TH1,#015h
MOV TL1,#0A0h
SETB TR1
LOOPCHECKBUTTON:
JNB TF1,LOOPCHECKBUTTON
CLR TF1
CLR TR1
JB P3.2,ENDMAIN
JB BELL,CLRBELLRING
CALL MODEBT
CALL SELECTBT
CALL INCBT
CALL DISPLAYINFO
CALL UPDATE
SJMP ENDMAIN
CLRBELLRING:
CLR BELL
SETB RINGED
MOV RPTIME,#00h
ENDMAIN:
MOV C,VB0
MOV RS0,C
MOV C,VB1
MOV RS1,C
RET
;--FUNCT CHECK ALARM----------------------
CHALARM:
JB ALSET,CHECKAL
SJMP CLOSECHECK
JNB BELL,CHECKAL
MOV R0,RPTIME
CJNE R0,#0A0h,TURNOFFBELL
INC RPTIME
SJMP CLOSECHECK
TURNOFFBELL:
CLR BELL
MOV RPTIME,#00h
SETB RINGED
CLOSECHECK:
RET
CHECKAL:
MOV A,HOURS
CJNE A,ALH,ENDCHECKALARM
MOV A,MINUTE
CJNE A,ALM,ENDCHECKALARM
JB RINGED,ENDCHECKALARMNOTCLEAREDRINGED
SETB BELL
SJMP ENDCHECKALARMNOTCLEAREDRINGED
ENDCHECKALARM:
CLR RINGED
ENDCHECKALARMNOTCLEAREDRINGED:
RET
;--FUNCT CHECK INCREASE BUTTON------------
INCBT:;VAR2 CHUA ADDR CAN GHI
MOV C,D1
ORL C,D2
ORL C,D3
ORL C,D4
JNC ENDCHECKINCBUTTON
JB BTINC,ENDCHECKINCBUTTON
JNB D1,INCD2
JB YM,ENDWRITED1
JNB HM,SETDAYINC
MOV R0,#HOURS
SJMP INCVL
SETDAYINC:
JNB DM,SETALINC
MOV R0,#DAY
SJMP INCVL
SETALINC:
MOV R0,#ALH
INCVL:
MOV A,@R0
CALL HIGHBYTE
JNB D3,D1CONDITION
JB HM,D3HMALMCONDITION
JNB AM,D3MONTHCONDITION
D3HMALMCONDITION:
CJNE A,#05h,INCFIRST
SJMP SETFIRSTTOZERO
D3MONTHCONDITION:
JNB DM,D3YEARCONDITION
CJNE A,#01h,INCFIRST
SJMP SETFIRSTTOZERO
D3YEARCONDITION:
CJNE A,#09h,INCFIRST
SJMP SETFIRSTTOZERO
D1CONDITION:
JNB AM,HOURSCHECKING
SJMP AHFIRSTCONDITION
HOURSCHECKING:
JNB HM,DAYFIRSTCONDITION
AHFIRSTCONDITION:
CJNE A,#02h,INCFIRST
SJMP SETFIRSTTOZERO
DAYFIRSTCONDITION:
CJNE A,#03h,INCFIRST
SETFIRSTTOZERO:
CLR A
SJMP WRITEBACKHIGH
INCFIRST:
INC A
WRITEBACKHIGH:
CALL WRHIGH
ENDWRITED1:
SJMP ENDCHECKINCBUTTON
INCD2:
JNB D2,INCD34
GETVALUED2AND4:
JB YM,ENDWRITED2
JNB HM,DAYLOWVL
MOV R0,#HOURS
SJMP INCSECONDVL
DAYLOWVL:
JNB DM,ALOWVL
MOV R0,#DAY
SJMP INCSECONDVL
ALOWVL:
MOV R0,#ALH
INCSECONDVL:
MOV A,@R0
CALL LOWBYTE
CJNE A,#09h,INCSECONDNUM
CLR A
SJMP WRITEBACKSECONDNUM
INCSECONDNUM:
INC A
WRITEBACKSECONDNUM:
CALL WRLOW 
ENDWRITED2:
SJMP ENDCHECKINCBUTTON
INCD34:
SJMP D34GETVALUE
DOOTHER:
JB D3,INCVL
SJMP INCSECONDVL
ENDCHECKINCBUTTON:
RET
D34GETVALUE:
JNB HM,GETMONTHVL
MOV R0,#MINUTE
SJMP DOOTHER
GETMONTHVL:
JNB DM,GETALVL
MOV R0,#MONTH
SJMP DOOTHER
GETALVL:
JNB AM,GETYEARVL
MOV R0,#ALM
SJMP DOOTHER
GETYEARVL:
MOV R0,#YEAR
SJMP DOOTHER
;--FUNCT GETTHEHIGHBYTE-------------------
HIGHBYTE:
;ACC CHUA GIA TRI CAN LAY HIGH BYTE , SAU HAM ACC CHUA GIA TRI CAN LAY
SWAP A
ANL A,#0Fh
RET
;--FUNCT GETLOWBYTE--------------------
LOWBYTE:
;ACC CHUA GIA TRI CAN LAY LOW BYTE , SAU HAM ACC CHUA GIA TRI CAN LAY
ANL A,#0Fh
RET
;--FUNCT WRITEHIGHBYTE-------------------
WRHIGH:;R0 DIA CHI O NHO CAN GHI
MOV VAR1,@R0
ANL VAR1,#0Fh
MOV @R0,VAR1
SWAP A
ANL A,#0F0h
ORL A,@R0
MOV @R0,A
RET
;--FUNCT WRITELOWBYTE-------------------
WRLOW:;R0 DIA CHI O NHO CAN GHI
MOV VAR1,@R0
ANL VAR1,#0F0h
MOV @R0,VAR1
ANL A,#0Fh
ORL A,@R0
MOV @R0,A
RET
;--FUNCT CHECK SELECT BUTTON--------------
SELECTBT:
JB BTSLCT,ENDCHECKSELECTBUTTON
JNB D1,CHECKD2
CLR D1
SETB D2
SJMP ENDCHECKSELECTBUTTON
CHECKD2:
JNB D2,CHECKD3
CLR D2
SETB D3
SJMP ENDCHECKSELECTBUTTON
CHECKD3:
JNB D3,CHECKD4
CLR D3
SETB D4
SJMP ENDCHECKSELECTBUTTON
CHECKD4:
JNB D4,NONESELECTEDLED
CLR D4
JB HM,CLRBITHC
JB DM,CLRBITDC
JB YM,CLRBITYC
SJMP D4CHECKAL
CLRBITHC:
CLR HC
SJMP ENDCHECKSELECTBUTTON
CLRBITDC:
CLR DC
SJMP ENDCHECKSELECTBUTTON
CLRBITYC:
CLR YC
SJMP ENDCHECKSELECTBUTTON
D4CHECKAL:
JNB D4,NONESELECTEDLED
CLR D4
JNB AM,ENDCHECKSELECTBUTTON
SETB ALSET
SJMP ENDCHECKSELECTBUTTON
NONESELECTEDLED:
SETB D1
JNB ALSET,CHECKOTHERMODE
CLR ALSET
SJMP ENDCHECKSELECTBUTTON
CHECKOTHERMODE:
JB HM,SETCHAGEHOURS
JB DM,SETCHAGEDAY
SETB YC
SJMP ENDCHECKSELECTBUTTON
SETCHAGEDAY:
SETB DC
SJMP ENDCHECKSELECTBUTTON
SETCHAGEHOURS:
SETB HC
ENDCHECKSELECTBUTTON:
RET
;--FUNCT CHECK MODE BUTTON----------
MODEBT:
JB BTMODE,ENDBTMODECHECK
ANL 20h,#080h ;SET D1=D2=D3=D4=HC=DC=YC=0
JNB HM,CHECKDAYMODE
CLR HM
SETB DM
SJMP ENDBTMODECHECK
CHECKDAYMODE:
JNB DM,CHECKYEARMODE
SETB YM
CLR SPACEDOT
CLR DM
SJMP ENDBTMODECHECK 
CHECKYEARMODE:
JNB YM,CHECKALARMMODE
SETB AM
CLR YM
SETB SPACEDOT
SJMP ENDBTMODECHECK 
CHECKALARMMODE:
JB ALSET,KEEPALARMLED
CLR AM
KEEPALARMLED:
SETB HM
ENDBTMODECHECK:
RET
;--FUNCT UPDATE---------------------
UPDATE:
JNB UPDATTING,NOTUPDATTING
RET
NOTUPDATTING:
SETB UPDATTING
MOV C,RS0
MOV LB0,C
MOV C,RS1
MOV LB1,C
SETB RS0
CLR RS1
CALL CHALARM
JB HC,CHANGEHOURS
JNB HC,GETHOURS
CHKD:
JB DC,CHAGEDAY
JNB DC,GETDAY
CHKY:
JB YC,CHAGEYEAR
JNB YC,GETYEAR
CHANGEHOURS:
MOV BUFF,MINUTE
MOV ADDRSEG,#01h
MOV R6,#02h
MOV R7,HOURS
CALL WRITEBUFF
SJMP CHKD
CHAGEDAY:
MOV BUFF,DAY
MOV ADDRSEG,#04h;DAY SEG
MOV R6,#05h;MONTH SEG
MOV R7,MONTH
CALL WRITEBUFF
SJMP CHKY
CHAGEYEAR:
MOV ADDRSEG,#06h
MOV BUFF,YEAR
CALL WRITE
SJMP ENDUPDATE
GETHOURS:
MOV ADDRSEG,#01h ;MINUTE
MOV BUFF,#MINUTE
CALL READ
MOV ADDRSEG,#02h ;HOURS
MOV BUFF,#HOURS
CALL READ
SJMP CHKD
GETDAY:
MOV ADDRSEG,#04h ;DAY
MOV BUFF,#DAY
CALL READ
MOV ADDRSEG,#05h ;MONTH
MOV BUFF,#MONTH
CALL READ
SJMP CHKY
GETYEAR:
MOV ADDRSEG,#06h ;YEAR
MOV BUFF,#YEAR
CALL READ
ENDUPDATE:
CALL DISPLAYINFO
MOV C,LB0
MOV RS0,C
MOV C,LB1
MOV RS1,C
CLR UPDATTING
RET
;--FUNCT DISPLAYINFO----------------
;VAR1 LA LED ADDRESS
;VAR2 LA ADDRESS CUA 2 CHU SO CAN GHI
DISPLAYINFO:
MOV VAR1,#04h ;DE CO THE SU DUNG GIA TRI 0
JB HM,HOURSMODE
JB DM,DAYMONTHMODE
JB YM,YEARMODE
JB AM,ALARMMODE
MOV VAR2,ALH
SJMP GETVALUE
HOURSMODE:
MOV VAR2,HOURS
MOV VAR3,MINUTE
SJMP GETVALUE
DAYMONTHMODE:
MOV VAR2,DAY
MOV VAR3,MONTH
SJMP GETVALUE
YEARMODE:;TAO KIEU 20XX
MOV VAR2,#020h
MOV VAR3,YEAR
SJMP GETVALUE
ALARMMODE:
MOV VAR2,ALH
MOV VAR3,ALM
GETVALUE:
MOV A,20h ;NOI DUNG O NHO TRANG THAI
MOV R0,VAR1
LOOPGETDOTBIT:
RRC A
DJNZ R0,LOOPGETDOTBIT
MOV DOT,C
DEC VAR1
MOV R0,VAR1
CJNE R0,#01h,ENDCHECK
MOV VAR2,VAR3
ENDCHECK:
MOV A,VAR2
SWAP A
MOV NUM,#0Fh
ANL NUM,A
MOV VAR2,A
GETLEDADDRESS:
MOV DPTR,#ADDRESSLED
MOV A,VAR1
MOVC A,@A+DPTR;A DA CHUA ADDRESS CUA LED
MOV DPTR,#RESS
MOV R0,A
MOVC A,@A+DPTR
MOV SETCL,A
INC R0
MOV A,R0
MOVC A,@A+DPTR
MOV CLRCL,A
INC R0
MOV A,R0
MOVC A,@A+DPTR
MOV SETDTA,A
INC R0
MOV A,R0
MOVC A,@A+DPTR
MOV CLRDTA,A
INC R0
MOV A,R0
MOVC A,@A+DPTR
MOV SETDIS,A
INC R0
MOV A,R0
MOVC A,@A+DPTR
MOV CLRDIS,A
MOV DPTR,#NUMBERRECORD
MOV A,NUM
MOVC A,@A+DPTR
JNB DOT,DODISPLAY
DISPLAYDOT:
ORL A,#01h
DODISPLAY:
MOV R0,#08h
PUSHBIT:
RRC A
MOV R1,A
MOV A,P1
JC BITSETTED
ANL A,CLRDTA
SJMP GENSIGNAL
BITSETTED:
ORL A,SETDTA
GENSIGNAL:
MOV P1,A
ORL A,SETCL
MOV P1,A
ANL A,CLRCL
MOV P1,A
MOV A,R1
DJNZ R0,PUSHBIT
MOV A,P2
ORL A,SETDIS
MOV P2,A
ANL A,CLRDIS
MOV P2,A
INC VAR1
DJNZ VAR1,FARJUMP
SJMP ENDDISPLAYINFO
FARJUMP:
AJMP GETVALUE
ENDDISPLAYINFO:
RET
;--FUNCT WRITE BUFF-----------------
;GHI VAO NOI DUNG CHUA TRONG ADDRSEG VA R6 BOI NOI DUNG CHUA TRONG BUFF VA R7 
WRITEBUFF:
CALL WRITE
MOV ADDRSEG,R6
MOV BUFF,R7
CALL WRITE
RET
;--SEND ADDRESS1307--------------------------
SENDADDR1307:
JC READMODE 
MOV A,#0D0h ;ADDRESS CUA DS1307 + BIT WRITE
SJMP BEGINSEND
READMODE:
MOV A,#0D1h
BEGINSEND:
MOV R0,#08h
CALL STARTTRANS
LOOP:
RLC A
JC ONE
CALL SBIT0
SJMP NEXTLOOP
ONE:
CALL SBIT1
NEXTLOOP:
DJNZ R0,LOOP
RET
;--FUNCT READ---------------------------------
READ:;DOC DATA CUA THANH GHI CO DIA CHI CHUA TRONG ADDRSEG VAO O NHO CO DIA CHI CHUA  TRONG BUFF
CLR RWB
CALL SENDADDR1307 ;SET DIA CHI CAN DOC
CALL GETACK
JNB SCL,SENDADDRSEGREAD
SJMP ENDREAD
SENDADDRSEGREAD:
MOV A,ADDRSEG
MOV R0,#08h
LOOPADDRSEND:
RLC A
JC ONEBIT
CALL SBIT0
SJMP LOOPAGAIN
ONEBIT:
CALL SBIT1
LOOPAGAIN:
DJNZ R0,LOOPADDRSEND
CALL GETACK
JB SCL,ENDREAD
CALL STOPTRANS
SETB RWB
CALL SENDADDR1307 ;DOC DU LIEU
CALL GETACK
JNB SCL,READSEG
SJMP ENDREAD
READSEG:
MOV R0,#08h
GETBITLOOP:
CALL GETBIT
RLC A
DJNZ R0,GETBITLOOP
MOV R0,BUFF
MOV @R0,A
CALL SENDNACK
ENDREAD:
RET
;--NOTACK------------------------------------
SENDNACK:
SETB SDA
CALL DLSIG
SETB SCL
CALL DLSIG
CLR SCL
CALL DLSIG
CALL STOPTRANS
RET
;--GETBIT------------------------------------
GETBIT:;BIT DUOC GET NAM TRONG C
SETB SDA
SETB SCL
CALL DLSIG
MOV C,SDA
CLR SCL
CALL DLSIG
RET
;--FUNCT WRITE--------------------------------
WRITE:;GHI DATA TRONG BUFF VAO THANH GHI CO DIA CHI CHUA TRONG ADDRSEG
CLR RWB
CALL SENDADDR1307
CALL GETACK
JNB SCL,SENDSEGBUF
SJMP ENDWRITE
SENDSEGBUF:
MOV R0,#02h
SENDLOOP:
MOV A,#02Dh
ADD A,R0
MOV R0,A
MOV A,@R0 ;LAY DU LIEU TU O NHO BUFF HOAC ADDRESEG
MOV R1,#08h
LOOPSENDBIT:
RLC A
JC BITHIGH
CALL SBIT0
SJMP CONTINUELOOP
BITHIGH:
CALL SBIT1
CONTINUELOOP:
DJNZ R1,LOOPSENDBIT
CALL GETACK
JNB SCL,NEXTSEND
SJMP ENDWRITE
NEXTSEND:
CLR C
MOV A,R0
MOV R0,#02Dh
SUBB A,R0
MOV R0,A
DJNZ R0,SENDLOOP
CALL STOPTRANS
ENDWRITE:
RET
;--FUNCT DLSIG-----------------
DLSIG:
NOP
RET
;--FUNCT STARSIGNAL-----------------
STARTTRANS: ;TAO TIN HIEU START CHAN SCL = SDA=0
CLR SCL
SETB SDA
SETB SCL
CALL DLSIG
CLR SDA
CALL DLSIG
CLR SCL
RET
;--FUNCT SEND ONEBIT---------------- 
SBIT1:;SDA=SCL=0
SETB SDA
SETB SCL
CALL DLSIG
CLR SCL
CLR SDA
RET
;--FUNCT SEND ZEROBIT---------------
SBIT0:;SDA=SCL=0
CLR SDA
SETB SCL
CALL DLSIG
CLR SCL
RET
;--GET ACK-------------------------
GETACK:;SDA=SCL=0 => ACK ,SDA=SCL=1 =>NOT ACK
SETB SDA
SETB SCL
CALL DLSIG
JB SDA,CANCEL
CLR SCL
RET
CANCEL:
CALL STOPTRANS;TU DONG PHAT XUNG STOP TRANS
RET
;--FUNCT STOPSIGNAL----------------
STOPTRANS:;TAO TIN HIEU KET THUC TRUYEN
CLR SCL
CLR SDA
NOP
SETB SCL
CALL DLSIG
SETB SDA
CALL DLSIG
RET
;--------RECORD----------------------
RESS:
DB 01h,0FEh,02h,0FDh,01h,0FEh
DB 04h,0FBh,08h,0F7h,02h,07Dh
DB 010h,0EFh,020h,0DFh,04h,0FBh
DB 040h,0BFh,080h,07Fh,08h,0F7h
;  CL    CL   DTA DTA  DIS DIS
NUMBERRECORD:
DB 11111100B ;0
DB 01100000B ;1
DB 11011010B ;2
DB 11110010B ;3
DB 01100110B ;4
DB 10110110B ;5
DB 10111110B ;6
DB 11100000B ;7
DB 11111110B ;8
DB 11110110B ;9
ADDRESSLED:
DB 012h,0Ch,06h,00h ; LED 4 3 2 1
END
